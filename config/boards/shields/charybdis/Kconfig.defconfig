## config/boards/shields/charybdis/Kconfig.defconfig
```kconfig
# Copyright (c) 2020 The ZMK Contributors
# SPDX-License-Identifier: MIT

if SHIELD_CHARYBDIS_DONGLE

config ZMK_KEYBOARD_NAME
	default "Charybdis"

config ZMK_SPLIT_ROLE_CENTRAL
	default y

config ZMK_SPLIT
	default y

config ZMK_SPLIT_BLE_CENTRAL_PERIPHERALS
	default 2

# peripherals (2) + BT profiles (5)
config BT_MAX_CONN
	default 7

config BT_MAX_PAIRED
	default 7

config ZMK_POINTING
	default y

config ZMK_POINTING_SMOOTH_SCROLLING
	default n

endif

if SHIELD_CHARYBDIS_RIGHT

config SPI
	default y

config ZMK_POINTING
	default y

config ZMK_POINTING_SMOOTH_SCROLLING
	default n

endif

if SHIELD_CHARYBDIS_LEFT || SHIELD_CHARYBDIS_RIGHT

config ZMK_SPLIT
	default y

endif
```

## config/boards/shields/clone_advantage/Kconfig.defconfig
```kconfig
# Copyright (c) 2020 The ZMK Contributors
# SPDX-License-Identifier: MIT

if SHIELD_ClONE_ADVANTAGE_LEFT

config ZMK_KEYBOARD_NAME
	default "clone advantage"

config ZMK_SPLIT_ROLE_CENTRAL
	default y

endif

if SHIELD_ClONE_ADVANTAGE_LEFT || SHIELD_ClONE_ADVANTAGE_RIGHT

config ZMK_SPLIT
	default y

endif
```

## config/boards/shields/clone_advantage/Kconfig.shield
```kconfig
# Copyright (c) 2020 Pete Johanson
# SPDX-License-Identifier: MIT

config SHIELD_ClONE_ADVANTAGE_LEFT
	def_bool $(shields_list_contains,clone_advantage_left)

config SHIELD_ClONE_ADVANTAGE_RIGHT
	def_bool $(shields_list_contains,clone_advantage_right)
```

## config/boards/shields/mov/Kconfig.defconfig
```kconfig
# Copyright (c) 2020 The ZMK Contributors
# SPDX-License-Identifier: MIT

if SHIELD_MOV

config ZMK_KEYBOARD_NAME
    default "charybdis"

config SPI
    default y

config ZMK_POINTING
    default y

endif
```

## config/boards/shields/xiaorne/Kconfig.defconfig
```kconfig
# Copyright (c) 2020 The ZMK Contributors
# SPDX-License-Identifier: MIT

if SHIELD_XIAORNE_LEFT

config ZMK_KEYBOARD_NAME
	default "xiaorne"

config ZMK_SPLIT_ROLE_CENTRAL
	default y

endif

if SHIELD_XIAORNE_LEFT || SHIELD_XIAORNE_RIGHT

config ZMK_SPLIT
	default y

endif
```

## config/boards/shields/xiaorne/Kconfig.shield
```kconfig
# Copyright (c) 2020 Pete Johanson
# SPDX-License-Identifier: MIT

config SHIELD_XIAORNE_LEFT
	def_bool $(shields_list_contains,xiaorne_left)

config SHIELD_XIAORNE_RIGHT
	def_bool $(shields_list_contains,xiaorne_right)
```

## config/west.yml
```yaml
manifest:
  remotes:
    - name: taufiqr
      url-base: https://github.com/taufiqr
    - name: zmkfirmware
      url-base: https://github.com/zmkfirmware
    - name: petejohanson
      url-base: https://github.com/petejohanson
    - name: badjeff
      url-base: https://github.com/badjeff
  projects:
    - name: zmk
      remote: zmkfirmware
      revision: main
      import: app/west.yml
    - name: zmk-pmw3610-driver
      remote: badjeff
      revision: main
  self:
    path: config
```
